## conf/layer.conf
```bitbake
# We have a conf and classes directory, add to BBPATH
BBPATH .= ":${LAYERDIR}"

# We have recipes-* directories, add to BBFILES
BBFILES += "${LAYERDIR}/recipes-*/*/*.bb \
            ${LAYERDIR}/recipes-*/*/*.bbappend"

BBFILE_COLLECTIONS += "meta-imx-fde-demo"
BBFILE_PATTERN_meta-imx-fde-demo = "^${LAYERDIR}/"
BBFILE_PRIORITY_meta-imx-fde-demo = "9"

LAYERSERIES_COMPAT_meta-imx-fde-demo = "sumo"
```

## imx_optee_os_security_enhancements/meta-nxp-security-enhancements/conf/layer.conf
```bitbake
# We have a conf and classes directory, add to BBPATH
BBPATH .= ":${LAYERDIR}"

# We have recipes-* directories, add to BBFILES
BBFILES += "${LAYERDIR}/recipes-*/*/*.bb \
            ${LAYERDIR}/recipes-*/*/*.bbappend"

BBFILE_COLLECTIONS += "meta-nxp-security-enhancements"
BBFILE_PATTERN_meta-nxp-security-enhancements = "^${LAYERDIR}/"
BBFILE_PRIORITY_meta-nxp-security-enhancements = "6"

LAYERDEPENDS_meta-nxp-security-enhancements = "core"
LAYERSERIES_COMPAT_meta-nxp-security-enhancements = "sumo honister"
```

## libcastauth-imx/meta-nxp-gva/conf/layer.conf
```bitbake
# We have a conf and classes directory, add to BBPATH
BBPATH .= ":${LAYERDIR}"

# We have recipes-* directories, add to BBFILES
BBFILES += "${LAYERDIR}/recipes-*/*/*.bb \
            ${LAYERDIR}/recipes-*/*/*.bbappend"

BBFILE_COLLECTIONS += "meta-nxp-gva"
BBFILE_PATTERN_meta-nxp-gva = "^${LAYERDIR}/"
BBFILE_PRIORITY_meta-nxp-gva = "6"

LAYERSERIES_COMPAT_meta-nxp-gva = "sumo"
```

## meta-caam-pkc-sec/conf/layer.conf
```bitbake
# We have a conf and classes directory, add to BBPATH
BBPATH .= ":${LAYERDIR}"

# We have recipes-* directories, add to BBFILES
BBFILES += "${LAYERDIR}/recipes-*/*/*.bb \
            ${LAYERDIR}/recipes-*/*/*.bbappend"

BBFILE_COLLECTIONS += "meta-caam-pkc-sec"
BBFILE_PATTERN_meta-caam-pkc-sec = "^${LAYERDIR}/"
BBFILE_PRIORITY_meta-caam-pkc-sec = "7"
LAYERSERIES_COMPAT_meta-caam-pkc-sec = "rocko sumo thud"
```

## meta-ecdsa-blackkey/conf/layer.conf
```bitbake
# We have a conf and classes directory, add to BBPATH
BBPATH .= ":${LAYERDIR}"

# We have recipes-* directories, add to BBFILES
BBFILES += "${LAYERDIR}/recipes-*/*/*.bb \
            ${LAYERDIR}/recipes-*/*/*.bbappend"

BBFILE_COLLECTIONS += "meta-ecdsa-blackkey"
BBFILE_PATTERN_meta-ecdsa-blackkey = "^${LAYERDIR}/"
BBFILE_PRIORITY_meta-ecdsa-blackkey = "6"
LAYERSERIES_COMPAT_meta-ecdsa-blackkey = "sumo poky"
```

## meta-imx-ecdsa-sec/conf/layer.conf
```bitbake
# We have a conf and classes directory, add to BBPATH
BBPATH .= ":${LAYERDIR}"

# We have recipes-* directories, add to BBFILES
BBFILES += "${LAYERDIR}/recipes-*/*/*.bb \
            ${LAYERDIR}/recipes-*/*/*.bbappend"

BBFILE_COLLECTIONS += "meta-imx-ecdsa-sec"
BBFILE_PATTERN_meta-imx-ecdsa-sec = "^${LAYERDIR}/"
BBFILE_PRIORITY_meta-imx-ecdsa-sec = "10"
LAYERSERIES_COMPAT_meta-imx-ecdsa-sec = "warrior zeus"
```
